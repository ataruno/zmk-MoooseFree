## boards/shields/MoooseFree/Kconfig.defconfig
```kconfig
if SHIELD_MoooseFree_RIGHT

config ZMK_KEYBOARD_NAME
    default "MoooseFree"

config ZMK_SPLIT
    default y

config ZMK_SPLIT_ROLE_CENTRAL
    default y

config ZMK_SPLIT_BLE_CENTRAL_SPLIT_RUN_STACK_SIZE
    int
    default 2048

endif


if SHIELD_MoooseFree_LEFT

config ZMK_SPLIT
    default y

config CONFIG_ZMK_SPLIT_BLE_PERIPHERAL_STACK_SIZE
    int
    default 2048

endif
```

## boards/shields/MoooseFree/Kconfig.shield
```kconfig
# Copyright (c) 2022 The ZMK Contributors
# SPDX-License-Identifier: MIT

config SHIELD_MoooseFree_LEFT
    def_bool $(shields_list_contains,MoooseFree_left)

config SHIELD_MoooseFree_RIGHT
    def_bool $(shields_list_contains,MoooseFree_right)
```

## config/boards/shields/MoooseFree/Kconfig.defconfig
```kconfig
if SHIELD_MoooseFree_RIGHT

config ZMK_KEYBOARD_NAME
    default "MoooseFree"

config ZMK_SPLIT_ROLE_CENTRAL
    default y

endif

if SHIELD_MoooseFree_LEFT || SHIELD_MoooseFree_RIGHT

config ZMK_SPLIT
    default y

endif
```

## config/west.yml
```yaml
manifest:
  remotes:
    - name: zmkfirmware
      url-base: https://github.com/zmkfirmware
    - name: ataruno-git
      url-base: https://github.com/ataruno
    - name: caksoylar
      url-base: https://github.com/caksoylar
  projects:
    - name: zmk
      remote: zmkfirmware
      revision: v0.3-branch
      import: app/west.yml
    - name: zmk-pmw3610-driver_zephyr3
      remote: ataruno-git
      revision: main
    - name: zmk-rgbled-widget
      remote: caksoylar
      revision: main
  self:
    path: config
```

## modules/anti_scroll/dts/bindings/behaviors/zmk,behavior-anti-scroll.yaml
```yaml
# SPDX-License-Identifier: MIT

description: Anti-scroll rotate behavior with runaway protection

compatible: "zmk,behavior-anti-scroll"

include: one_param.yaml

properties:
  cooldown-ms:
    type: int
    required: false
    default: 200
    description: Time to ignore events after runaway detected

  window-ms:
    type: int
    required: false
    default: 100
    description: Time window to count events

  threshold:
    type: int
    required: false
    default: 20
    description: Number of events in window to trigger runaway

sensor-binding-cells:
  - step
  - direction
```
